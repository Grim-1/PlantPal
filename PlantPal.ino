#include <SPI.h>
#include <Wire.h>
#include <Adafruit_GFX.h>
#include "Adafruit_SH1106.h"
#include <Servo.h>
#define OLED_RESET 14

Adafruit_SH1106 display(OLED_RESET);
const unsigned char PROGMEM normal[] ={
0x00, 0x00, 0x00, 0x00, 0x00, 0x00, 0x00, 0x00, 0x00, 0x00, 0x00, 0x00, 0x00, 0x00, 0x00, 0x00,
0x00, 0x00, 0x00, 0x00, 0x00, 0x00, 0x00, 0x00, 0x00, 0x00, 0x00, 0x00, 0x00, 0x00, 0x00, 0x00,
0x00, 0x00, 0x00, 0x00, 0x00, 0x00, 0x00, 0x00, 0x00, 0x00, 0x00, 0x00, 0x00, 0x00, 0x00, 0x00,
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0x00, 0x00, 0x00, 0x00, 0x00, 0x00, 0x00, 0x00, 0x00, 0x00, 0x00, 0x00, 0x00, 0x00, 0x00, 0x00};

const unsigned char PROGMEM furious[] ={
0x00, 0x00, 0x00, 0x00, 0x00, 0x00, 0x00, 0x00, 0x00, 0x00, 0x00, 0x00, 0x00, 0x00, 0x00, 0x00,
0x00, 0x00, 0x00, 0x00, 0x00, 0x00, 0x00, 0x00, 0x00, 0x00, 0x00, 0x00, 0x00, 0x00, 0x00, 0x00,
0x00, 0x00, 0x00, 0x00, 0x00, 0x00, 0x00, 0x00, 0x00, 0x00, 0x00, 0x00, 0x00, 0x00, 0x00, 0x00,
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0x00, 0x00, 0x00, 0x00, 0x00, 0x00, 0x00, 0x00, 0x00, 0x00, 0x00, 0x00, 0x00, 0x00, 0x00, 0x00
};
const unsigned char PROGMEM cute[] = {
  0x00, 0x00, 0x00, 0x00, 0x00, 0x00, 0x00, 0x00, 0x00, 0x00, 0x00, 0x00, 0x00, 0x00, 0x00, 0x00,
  0x00, 0x00, 0x00, 0x00, 0x00, 0x00, 0x00, 0x00, 0x00, 0x00, 0x00, 0x00, 0x00, 0x00, 0x00, 0x00,
  0x00, 0x00, 0x00, 0x00, 0x00, 0x00, 0x00, 0x00, 0x00, 0x00, 0x00, 0x00, 0x00, 0x00, 0x00, 0x00,
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  0x00, 0x00, 0x00, 0x00, 0x00, 0x00, 0x00, 0x00, 0x00, 0x00, 0x00, 0x00, 0x00, 0x00, 0x00, 0x00
};

const unsigned char PROGMEM neutral[] = {
0x00, 0x00, 0x00, 0x00, 0x00, 0x00, 0x00, 0x00, 0x00, 0x00, 0x00, 0x00, 0x00, 0x00, 0x00, 0x00,
0x00, 0x00, 0x00, 0x00, 0x00, 0x00, 0x00, 0x00, 0x00, 0x00, 0x00, 0x00, 0x00, 0x00, 0x00, 0x00,
0x00, 0x00, 0x00, 0x00, 0x00, 0x00, 0x00, 0x00, 0x00, 0x00, 0x00, 0x00, 0x00, 0x00, 0x00, 0x00,
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0x00, 0x00, 0x00, 0x00, 0x00, 0x00, 0x00, 0x00, 0x00, 0x00, 0x00, 0x00, 0x00, 0x00, 0x00, 0x00
};

const unsigned char PROGMEM blink[] = {
0x00, 0x00, 0x00, 0x00, 0x00, 0x00, 0x00, 0x00, 0x00, 0x00, 0x00, 0x00, 0x00, 0x00, 0x00, 0x00,
0x00, 0x00, 0x00, 0x00, 0x00, 0x00, 0x00, 0x00, 0x00, 0x00, 0x00, 0x00, 0x00, 0x00, 0x00, 0x00,
0x00, 0x00, 0x00, 0x00, 0x00, 0x00, 0x00, 0x00, 0x00, 0x00, 0x00, 0x00, 0x00, 0x00, 0x00, 0x00,
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0x00, 0x00, 0x00, 0x00, 0x00, 0x00, 0x00, 0x00, 0x00, 0x00, 0x00, 0x00, 0x00, 0x00, 0x00, 0x00
};
const unsigned char PROGMEM sad[] = {
0x00, 0x00, 0x00, 0x00, 0x00, 0x00, 0x00, 0x00, 0x00, 0x00, 0x00, 0x00, 0x00, 0x00, 0x00, 0x00,
0x00, 0x00, 0x00, 0x00, 0x00, 0x00, 0x00, 0x00, 0x00, 0x00, 0x00, 0x00, 0x00, 0x00, 0x00, 0x00,
0x00, 0x00, 0x00, 0x00, 0x00, 0x00, 0x00, 0x00, 0x00, 0x00, 0x00, 0x00, 0x00, 0x00, 0x00, 0x00,
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0x00, 0x00, 0x00, 0x00, 0x00, 0x00, 0x00, 0x00, 0x00, 0x00, 0x00, 0x00, 0x00, 0x00, 0x00, 0x00
};

const unsigned char PROGMEM sohappy[] ={
0x00, 0x00, 0x00, 0x00, 0x00, 0x00, 0x00, 0x00, 0x00, 0x00, 0x00, 0x00, 0x00, 0x00, 0x00, 0x00,
0x00, 0x00, 0x00, 0x00, 0x00, 0x00, 0x00, 0x00, 0x00, 0x00, 0x00, 0x00, 0x00, 0x00, 0x00, 0x00,
0x00, 0x00, 0x00, 0x00, 0x00, 0x00, 0x00, 0x00, 0x00, 0x00, 0x00, 0x00, 0x00, 0x00, 0x00, 0x00,
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0x00, 0x00, 0x00, 0x00, 0x00, 0x00, 0x00, 0x00, 0x00, 0x00, 0x00, 0x00, 0x00, 0x00, 0x00, 0x00
};
// Define pins
const int ldrLeft = A5;
const int ldrCenter = A6;
const int ldrRight = A7;
const int motorLeftForward = 1;
const int motorLeftBackward = A0;
const int motorRightForward = 2;
const int motorRightBackward = A1;
const int moisture = A2;
const int trigPin = 6;              // Ultrasonic sensor trigger pin
const int echoPin = 5;              // Ultrasonic sensor echo pin
const int servoPin = 7;             // Servo motor pin for ultrasonic sensor mount
const int irLeft = 4;               // Left IR sensor for edge detection
const int irRight = 3;              // Right IR sensor for edge detection

// Thresholds
const int lightThreshold = 500;     // Adjust this based on your light environment
const int minDistance = 10;         // Minimum distance for obstacle detection in 
Servo ultrasonicServo;

void setup() {
  display.begin(SH1106_SWITCHCAPVCC, 0x3C);
  display.display();
  display.clearDisplay();
  display.setTextSize(0);
  display.setFont();
  display.setTextColor(WHITE);
  face(0, 0, 0, 0, 0, 0, 1000, 1000);
  Serial.begin(9600);
  
  // Initialize LDR pins as inputs
  pinMode(ldrLeft, INPUT);
  pinMode(ldrCenter, INPUT);
  pinMode(ldrRight, INPUT);

  // Initialize motor control pins as outputs
  pinMode(motorLeftForward, OUTPUT);
  pinMode(motorLeftBackward, OUTPUT);
  pinMode(motorRightForward, OUTPUT);
  pinMode(motorRightBackward, OUTPUT);

  // Initialize ultrasonic sensor pins
  pinMode(trigPin, OUTPUT);
  pinMode(echoPin, INPUT);

  // Initialize IR sensor pins for edge detection
  pinMode(irLeft, INPUT);
  pinMode(irRight, INPUT);

  // Attach the servo
  ultrasonicServo.attach(servoPin);
  
  Serial.println("Motor control, obstacle avoidance, and edge detection initialized.");
}

void loop() {
  // LDR readings for motor control
  int leftLight = analogRead(ldrLeft);
  int centerLight = analogRead(ldrCenter);
  int rightLight = analogRead(ldrRight);
  int moistureout = digitalRead(moisture);

  // IR sensor readings for edge detection
  bool edgeDetectedLeft = digitalRead(irLeft) == HIGH;   // Assuming LOW means edge detected
  bool edgeDetectedRight = digitalRead(irRight) == HIGH; // Assuming LOW means edge detected

  // Print LDR and IR values for debugging
  Serial.print("LDR Left: ");
  Serial.print(leftLight);
  Serial.print(" | LDR Center: ");
  Serial.print(centerLight);
  Serial.print(" | LDR Right: ");
  Serial.println(rightLight);

  Serial.print("IR Left: ");
  Serial.print(edgeDetectedLeft);
  Serial.print(" | IR Right: ");
  Serial.println(edgeDetectedRight);

  // Perform ultrasonic sweep
  int obstacleDirection = performUltrasonicSweep();

  // Decision logic
  if (edgeDetectedLeft || edgeDetectedRight) {
    // Edge detected, stop and reverse or turn away from edge
    stopMovement();
    Serial.println("Edge detected! Stopping movement.");
    
    if (edgeDetectedLeft && !edgeDetectedRight) {
      turnRight();
      Serial.println("Turning Right to avoid left edge.");
    } else if (edgeDetectedRight && !edgeDetectedLeft) {
      turnLeft();
      Serial.println("Turning Left to avoid right edge.");
    } else {
      moveBackward();
      Serial.println("Both edges detected! Moving backward.");
    }
  } else if (obstacleDirection != -1) {
    // Obstacle detected, stop and turn away
    stopMovement();
    Serial.println("Obstacle detected! Stopping movement.");
    
    if (obstacleDirection < 60) {
      turnRight();
      Serial.println("Turning Right to avoid obstacle.");
    } else if (obstacleDirection > 60) {
      turnLeft();
      Serial.println("Turning Left to avoid obstacle.");
    }
  }else {
    // No obstacle or edge detected, move based on LDR readings
    if (centerLight > 750) {
      moveForward();
      Serial.println("Moving Forward");
    } else if (leftLight > 750) {
      turnRight();
      Serial.println("Turning Right");
    } else if (rightLight > 750) {
      turnLeft();
      Serial.println("Turning Left");
    } else {
      stopMovement();
      Serial.println("Stopped");
    }
  }

  delay(1000);
}

// Function to perform an ultrasonic sweep and return the direction of any detected obstacle
int performUltrasonicSweep() {
  int obstacleDirection = -1; // -1 means no obstacle detected within range
  int minDist = minDistance;

  // Sweep from 30 to 150 degrees
  for (int angle = 30; angle <= 150; angle += 30) {
    ultrasonicServo.write(angle);
    delay(300);  // Allow time for servo to reach position

    int distance = getDistance();
    Serial.print("Angle: ");
    Serial.print(angle);
    Serial.print(" | Distance: ");
    Serial.println(distance);

    // Check if obstacle is detected within the minimum distance
    if (distance > 0 && distance < minDist) {
      minDist = distance;
      obstacleDirection = angle;  // Record the angle of the closest obstacle
    }
  }

  return obstacleDirection;
}

// Function to measure distance using the ultrasonic sensor
int getDistance() {
  digitalWrite(trigPin, LOW);
  delayMicroseconds(2);
  digitalWrite(trigPin, HIGH);
  delayMicroseconds(10);
  digitalWrite(trigPin, LOW);
  
  long duration = pulseIn(echoPin, HIGH);
  int distance = duration * 0.034 / 2;  // Convert to centimeters

  return distance > 0 ? distance : -1;  // Return -1 if no valid reading
}

// Motor control functions
void moveForward() {
  digitalWrite(motorLeftForward, LOW);
  digitalWrite(motorLeftBackward, 20);
  digitalWrite(motorRightForward, 20);
  digitalWrite(motorRightBackward, LOW);
  face(1, 3, -16, 16, 1, 8, 500, 2500); // angry
  delay(1000);
  }

void moveBackward() {
  digitalWrite(motorLeftForward, 20);
  digitalWrite(motorLeftBackward, LOW);
  digitalWrite(motorRightForward, 20);
  digitalWrite(motorRightBackward, LOW);
  face(1, 3, -16, 16, 1, 8, 500, 2500); // furious
  delay(1000);
}

void turnLeft() {
  digitalWrite(motorLeftForward, 20);
  digitalWrite(motorLeftBackward, LOW);
  digitalWrite(motorRightForward, 20);
  digitalWrite(motorRightBackward, LOW);
  face(1, 1, -16, 16, 1, 8, 500, 2500); // SAD
  delay(1000);
}

void turnRight() {
  digitalWrite(motorLeftForward, LOW);
  digitalWrite(motorLeftBackward, 20);
  digitalWrite(motorRightForward, LOW);
  digitalWrite(motorRightBackward, 20);
  face(1, 3, -16, 16, 1, 8, 500, 2500); // furious
  delay(1000);
}

void stopMovement() {
  digitalWrite(motorLeftForward, LOW);
  digitalWrite(motorLeftBackward, LOW);
  digitalWrite(motorRightForward, LOW);
  digitalWrite(motorRightBackward, LOW);
  face(1, 2, -16, 16, 1, 8, 500, 2500); // SAD
  delay(1000);
}
void face(byte eye, byte eye_sub, char xmin, char xmax, char ymin, char ymax, int tmin, int tmax) {
  char x = random(xmin, xmax);
  char y = random(ymin, ymax);
  int t = random(tmin, tmax);
  switch (eye) {
    case 1:
      switch (eye_sub) {
      case 0:
          display.clearDisplay();
          display.drawBitmap(x, y, neutral, 128, 64, 1);
          display.display();
          delay(t);
          display.clearDisplay();
          display.drawBitmap(x, y, blink, 128, 64, 1);
          display.display();
          delay(1000);
        break;
      case 1:
          display.clearDisplay();
          display.drawBitmap(x, y, cute, 128, 64, 1);
          display.display();
          delay(t);
          display.clearDisplay();
          display.drawBitmap(x, y, blink, 128, 64, 1);
          display.display();
          delay(1000);
        break;
      case 2:
          display.clearDisplay();
          display.drawBitmap(x, y, sad, 128, 64, 1);
          display.display();
          delay(1000);
          // display.clearDisplay();
          // display.drawBitmap(x, y, blink, 128, 64, 1);
          // display.display();
          // delay(150);
        break;
      case 3:
          display.clearDisplay();
          display.drawBitmap(x, y, furious, 128, 64, 1);
          display.display();
          delay(1000);
          // display.clearDisplay();
          // display.drawBitmap(x, y, blink, 128, 64, 1);
          // display.display();
          // delay(150);
      break;
      case 4:
          display.clearDisplay();
          display.drawBitmap(x, y, neutral, 128, 64, 1);
          display.display();
          delay(1000);
          // display.clearDisplay();
          // display.drawBitmap(x, y, blink, 128, 64, 1);
          // display.display();
          // delay(150);
      break;
      case 5:
          display.clearDisplay();
          display.drawBitmap(x, y, sohappy, 128, 64, 1);
          display.display();
          delay(1000);
          // display.clearDisplay();
          // display.drawBitmap(x, y, blink, 128, 64, 1);
          // display.display();
          // delay(150);
      }
      break;
  }
}